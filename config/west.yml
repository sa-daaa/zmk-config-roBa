## config/west.yml
```yaml
manifest:
  remotes:
    - name: zmkfirmware
      url-base: https://github.com/zmkfirmware
    - name: badjeff
      url-base: https://github.com/badjeff
    - name: carrefinho
      url-base: https://github.com/carrefinho
    - name: kot149
      url-base: https://github.com/kot149
    - name: ssbb
      url-base: https://github.com/ssbb
    - name: cormoran
      url-base: https://github.com/cormoran
  projects:
    # ZMK: DYA Studio 用カスタム RPC サブシステム付き cormoran fork（ZMK v4/Zephyr 4.1）
    - name: zmk
      remote: cormoran
      revision: main+dya
      import: app/west.yml
    # zmk-0.4: badjeff driver の ZMK v4/Zephyr 4.1 対応ブランチ（compatible文字列・Kconfig名は main と同一）
    - name: zmk-pmw3610-driver
      remote: badjeff
      revision: zmk-0.4
    # Prospector ドングル用（carrefinho）。main は ZMK v0.3 専用のため Zephyr 4.1 対応ブランチを使用
    - name: prospector-zmk-module
      remote: carrefinho
      revision: feat/new-status-screens
    - name: zmk-mouse-gesture
      remote: kot149
      revision: v1
    - name: zmk-listeners
      remote: ssbb
      revision: v1
    # DYA Studio モジュール（すべて cormoran リポジトリ、main+dyaと同じmain追従）
    - name: zmk-module-ble-management
      remote: cormoran
      revision: main
    - name: zmk-module-battery-history
      remote: cormoran
      revision: main
    - name: zmk-module-settings-rpc
      remote: cormoran
      revision: main
    - name: zmk-module-runtime-input-processor
      remote: cormoran
      revision: main
    - name: zmk-feature-custom-settings
      remote: cormoran
      revision: main
    - name: zmk-feature-runtime-macro
      remote: cormoran
      revision: main
      import: true
    - name: zmk-feature-runtime-combo
      remote: cormoran
      revision: main
      import: true
  self:
    path: config
```
